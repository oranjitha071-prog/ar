AUTOSAR XML (schema 4-0-3)
package /ExamplePkg
  sw component type ExampleComponent
    internal behavior ExampleComponent_Internal
      runnable RunnableMain
      timing event Main_10ms: period=0.01, start-on-event=RunnableMain
package /EcuConfig
  ecuc module configuration ExampleEcuC: definition=EcuC, MaxNvmBlocks=64
